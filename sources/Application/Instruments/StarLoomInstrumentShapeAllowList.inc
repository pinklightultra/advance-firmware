/*
 * SPDX-License-Identifier: GPL-3.0-only
 *
 * Copyright (c) 2024 xiphonics, inc.
 *
 * This file is part of the picoTracker firmware
 */

// This file is intentionally included multiple times with different
// definitions of STARLOOM_INSTRUMENT_SHAPE. Comment out one line to remove that
// shape from the StarLoom instrument UI without changing Braids' enum indices.
// The order is intentionally shuffled. Disabled entries stay in their assigned
// positions so re-enabling one does not require choosing a new UI location.
// The names evoke a pocket-sized space opera while hinting at each sound.
STARLOOM_INSTRUMENT_SHAPE(MACRO_OSC_SHAPE_DIGITAL_FILTER_HP, "BLUESHFT")
STARLOOM_INSTRUMENT_SHAPE(MACRO_OSC_SHAPE_CHAOTIC_FEEDBACK_FM, "VOIDLOOP")
STARLOOM_INSTRUMENT_SHAPE(MACRO_OSC_SHAPE_FEEDBACK_FM, "LOOPBACK")
STARLOOM_INSTRUMENT_SHAPE(MACRO_OSC_SHAPE_VOWEL, "VOXSTAR")
STARLOOM_INSTRUMENT_SHAPE(MACRO_OSC_SHAPE_DIGITAL_FILTER_PK, "QUASAR")
    //STARLOOM_INSTRUMENT_SHAPE(MACRO_OSC_SHAPE_HARMONICS, "SPECTRA")
STARLOOM_INSTRUMENT_SHAPE(MACRO_OSC_SHAPE_SQUARE_SUB, "DARKCUBE")
STARLOOM_INSTRUMENT_SHAPE(MACRO_OSC_SHAPE_BOWED, "SUNBOW")
STARLOOM_INSTRUMENT_SHAPE(MACRO_OSC_SHAPE_VOSIM, "ALIEN")
STARLOOM_INSTRUMENT_SHAPE(MACRO_OSC_SHAPE_SAW_SYNC, "DOCKSAW")
    //STARLOOM_INSTRUMENT_SHAPE(MACRO_OSC_SHAPE_GRANULAR_CLOUD, "STARDUST")
STARLOOM_INSTRUMENT_SHAPE(MACRO_OSC_SHAPE_WAVE_MAP, "ATLAS")
STARLOOM_INSTRUMENT_SHAPE(MACRO_OSC_SHAPE_STRUCK_DRUM, "IMPACT")
STARLOOM_INSTRUMENT_SHAPE(MACRO_OSC_SHAPE_SAW_SUB, "TRENCH")
STARLOOM_INSTRUMENT_SHAPE(MACRO_OSC_SHAPE_PARTICLE_NOISE, "SPARKS")
STARLOOM_INSTRUMENT_SHAPE(MACRO_OSC_SHAPE_TRIPLE_SINE, "3MOONS")
STARLOOM_INSTRUMENT_SHAPE(MACRO_OSC_SHAPE_MORPH, "MUTATOR")
STARLOOM_INSTRUMENT_SHAPE(MACRO_OSC_SHAPE_TWIN_PEAKS_NOISE, "BINARY")
STARLOOM_INSTRUMENT_SHAPE(MACRO_OSC_SHAPE_FM, "WARP")
    //STARLOOM_INSTRUMENT_SHAPE(MACRO_OSC_SHAPE_TRIPLE_SQUARE, "CUBESAT")
    //STARLOOM_INSTRUMENT_SHAPE(MACRO_OSC_SHAPE_SNARE, "EJECT")
STARLOOM_INSTRUMENT_SHAPE(MACRO_OSC_SHAPE_BLOWN, "AIRLOCK")
STARLOOM_INSTRUMENT_SHAPE(MACRO_OSC_SHAPE_TRIPLE_RING_MOD, "ORBITALS")
    //STARLOOM_INSTRUMENT_SHAPE(MACRO_OSC_SHAPE_CYMBAL, "SHIELDS")
STARLOOM_INSTRUMENT_SHAPE(MACRO_OSC_SHAPE_WAVE_PARAPHONIC, "QUARTET")
STARLOOM_INSTRUMENT_SHAPE(MACRO_OSC_SHAPE_TRIPLE_SAW, "TRIDENT")
STARLOOM_INSTRUMENT_SHAPE(MACRO_OSC_SHAPE_DIGITAL_FILTER_BP, "COMMLINK")
    //STARLOOM_INSTRUMENT_SHAPE(MACRO_OSC_SHAPE_STRUCK_BELL, "MOONBELL")
STARLOOM_INSTRUMENT_SHAPE(MACRO_OSC_SHAPE_TRIPLE_TRIANGLE, "TRISTAR")
STARLOOM_INSTRUMENT_SHAPE(MACRO_OSC_SHAPE_TOY, "BLIPSHIP")
STARLOOM_INSTRUMENT_SHAPE(MACRO_OSC_SHAPE_KICK, "BOOSTER")
STARLOOM_INSTRUMENT_SHAPE(MACRO_OSC_SHAPE_DIGITAL_FILTER_LP, "REDSHIFT")
STARLOOM_INSTRUMENT_SHAPE(MACRO_OSC_SHAPE_SQUARE_SYNC, "PHASELOK")
STARLOOM_INSTRUMENT_SHAPE(MACRO_OSC_SHAPE_FILTERED_NOISE, "NEBULA")
STARLOOM_INSTRUMENT_SHAPE(MACRO_OSC_SHAPE_WAVE_LINE, "VECTOR")
STARLOOM_INSTRUMENT_SHAPE(MACRO_OSC_SHAPE_SAW_SQUARE, "CHIMERA")
STARLOOM_INSTRUMENT_SHAPE(MACRO_OSC_SHAPE_SINE_TRIANGLE, "ORIGAMI")
STARLOOM_INSTRUMENT_SHAPE(MACRO_OSC_SHAPE_VOWEL_FOF, "CHOIRBOT")
STARLOOM_INSTRUMENT_SHAPE(MACRO_OSC_SHAPE_DIGITAL_MODULATION, "BEACON")
STARLOOM_INSTRUMENT_SHAPE(MACRO_OSC_SHAPE_FLUTED, "COMET")
STARLOOM_INSTRUMENT_SHAPE(MACRO_OSC_SHAPE_CSAW, "STARSAW")
STARLOOM_INSTRUMENT_SHAPE(MACRO_OSC_SHAPE_CLOCKED_NOISE, "GEIGER")
STARLOOM_INSTRUMENT_SHAPE(MACRO_OSC_SHAPE_BUZZ, "PULSAR")
STARLOOM_INSTRUMENT_SHAPE(MACRO_OSC_SHAPE_SAW_COMB, "ANTENNA")
STARLOOM_INSTRUMENT_SHAPE(MACRO_OSC_SHAPE_SAW_SWARM, "DRONES")
STARLOOM_INSTRUMENT_SHAPE(MACRO_OSC_SHAPE_WAVETABLES, "STARLOG")
    //STARLOOM_INSTRUMENT_SHAPE(MACRO_OSC_SHAPE_PLUCKED, "STARHARP")
